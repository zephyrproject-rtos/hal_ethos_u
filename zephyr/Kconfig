## zephyr/Kconfig
```kconfig
# Copyright (c) 2021 Arm Limited. All rights reserved.
# SPDX-License-Identifier: Apache-2.0

config ARM_ETHOS_U
	bool "Ethos-U core driver"
	default y
	help
	  This option enables the Arm Ethos-U core driver.
```
